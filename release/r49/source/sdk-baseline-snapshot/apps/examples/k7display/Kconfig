## release/r49/source/sdk-baseline-snapshot/apps/examples/k7display/Kconfig
```kconfig
config EXAMPLES_K7DISPLAY
	bool "K7 F050008M01 explicit display trial (no automatic startup)"
	default n
	depends on ARCH_CHIP_RK3576 && BUILD_FLAT
	depends on RK3576_USB_DIAG && RK3576_USBHOST
```

## release/r49/source/sdk-baseline-snapshot/apps/examples/voicelink/Kconfig
```kconfig
config EXAMPLES_K7VOICE
	bool "K7 native VoiceLink integration"
	depends on EXAMPLES_K7RADIO_SHARED && HAVE_CXX && LIBCXX && CXX_EXCEPTION
	default n
	---help---
		Native network adapter and control core. ASR/TTS not integrated yet.
		Explicit probe/scan commands are integration diagnostics, not speech.

config EXAMPLES_K7VOICE_STAGED_ASSETS
	bool "Reserve upper model window for staged speech assets"
	depends on EXAMPLES_K7VOICE && RK3576_MODEL_ARENA
	default n
	---help---
		Use only the lower 512 MiB for the model heap. Keep the upper
		512 MiB mapped for explicitly verified ASR and TTS RAM resources.

config EXAMPLES_K7VOICE_KWS
	bool "Explicit small-model streaming keyword spotter"
	depends on EXAMPLES_K7VOICE && EXAMPLES_K7SOUND_SESSION
	default n
	---help---
		Requires separately built, SHA-verified real KWS and embedded model
		objects. Adds bounded k7kws diagnostics; does not start audio, move
		the gimbal, or change the legacy voice loop at boot.
```
